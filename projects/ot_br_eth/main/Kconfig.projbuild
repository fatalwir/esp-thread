## projects/ot_br_eth/main/Kconfig.projbuild
```kconfig
menu "Thread Border Router over Ethernet"

    config OT_BR_MDNS_HOSTNAME
        string "mDNS hostname advertised on the backbone"
        default "esp-ot-br"

    config OT_BR_SNTP_ENABLE
        bool "Synchronise wall-clock time over SNTP"
        default y
        help
            Started at boot; the SNTP service retries internally until the
            Ethernet link and DHCP have come up, so no ordering is required.

            This does NOT by itself set the clock on mesh nodes -- see README.

    config OT_BR_SNTP_SERVER
        string "SNTP server"
        depends on OT_BR_SNTP_ENABLE
        default "pool.ntp.org"
        help
            A hostname requires working DNS. Use a literal IP (your LAN's NTP
            server, or your router) if you would rather not depend on
            name resolution.

endmenu
```

## projects/ot_br_ppp/main/Kconfig.projbuild
```kconfig
menu "Thread Border Router over PPP"

    menu "PPP backbone (USB Serial/JTAG)"

        config OT_BR_PPP_USER
            string "PPP user name"
            default "esp-ot-br"
            help
                Name this board authenticates with (PAP or CHAP, whichever
                the upstream router asks for). Leave empty if the router does
                not require authentication.

                The router assigns everything else: this board's IPv4
                address, the gateway and the DNS server come over IPCP, and
                the IPv6 prefix for the mesh over DHCPv6-PD.

        config OT_BR_PPP_PASSWORD
            string "PPP password"
            default ""
            help
                Set it in network.defaults at the repository root rather
                than here, so it stays out of git.

        config OT_BR_PPP_RX_BUFFER_SIZE
            int "USB Serial/JTAG RX ring buffer (bytes)"
            default 2048
            range 256 16384
            help
                The peripheral FIFO is small and CDC-ACM has no hardware flow
                control, so give the driver room to absorb bursts.

        config OT_BR_PPP_TX_BUFFER_SIZE
            int "USB Serial/JTAG TX ring buffer (bytes)"
            default 2048
            range 256 16384

        config OT_BR_PPP_RX_CHUNK_SIZE
            int "Bytes read per usb_serial_jtag_read_bytes() call"
            default 512
            range 64 4096

        config OT_BR_PPP_RX_TASK_STACK
            int "PPP receive task stack size"
            default 4096

        config OT_BR_PPP_RX_TASK_PRIO
            int "PPP receive task priority"
            default 6

    endmenu

    menu "Services"

        config OT_BR_MDNS_HOSTNAME
            string "mDNS hostname advertised on the backbone"
            default "esp-ot-br"

        config OT_BR_SNTP_ENABLE
            bool "Synchronise wall-clock time over SNTP"
            default y
            help
                Started once the PPP link is up. Gives the border router real
                time, which the SRP/DNS-SD server and any logging benefit from.

                This does NOT by itself set the clock on mesh nodes. See the
                README for the two ways to do that.

        config OT_BR_SNTP_SERVER
            string "SNTP server"
            depends on OT_BR_SNTP_ENABLE
            default "pool.ntp.org"
            help
                A hostname needs working DNS through the backbone. If you would
                rather not depend on that, put a literal IP address here -- the
                LAN's own NTP server, or the upstream router.

        config OT_BR_SNTP_SYNC_TIMEOUT_MS
            int "How long to wait for the first sync (ms)"
            depends on OT_BR_SNTP_ENABLE
            default 15000

    endmenu

    menu "Web interface"

        config OT_BR_WEB_PASSWORD
            string "Initial password for the web interface"
            default ""
            help
                The web interface (status, settings, Thread dataset, firmware
                update, console) asks for user "admin" and this password. It
                can be changed from the interface itself; the new one is kept
                in NVS and survives firmware updates.

                Leave empty to keep the web interface off. Set it in
                network.defaults at the repository root rather than here, so
                it stays out of git.

        config OT_BR_WEB_PORT
            int "HTTP port"
            default 80
            range 1 65535

        config OT_BR_ALLOW_THREAD_DIAG
            bool "Allow OpenThread factory diagnostics (ot diag) by default"
            depends on OPENTHREAD_DIAG
            default n
            help
                Factory diagnostics (`ot diag start`, `ot diag send`, ...)
                take the radio off the Thread network for RF testing. The
                code is compiled in (CONFIG_OPENTHREAD_DIAG); this setting,
                also switchable in the web interface, decides whether the
                consoles accept the commands. `ot diag stop` always works.

        config OT_BR_WEB_HTTPS_PORT
            int "HTTPS port (0: no HTTPS)"
            default 443
            range 0 65535
            help
                The same interface over TLS, with a self-signed certificate
                the board creates on first boot and keeps in NVS. Plain HTTP
                stays available on OT_BR_WEB_PORT.

        config OT_BR_CONSOLE_BUFFER_SIZE
            int "Console history kept for the web console (bytes)"
            default 16384
            range 2048 65536
            help
                Everything printed to the UART console (logs, command output)
                is also kept in a ring buffer of this size, which the web
                console reads from.

    endmenu

endmenu
```
